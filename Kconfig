## Kconfig
```kconfig
# SPDX-FileCopyrightText: 2026 roolrz
# SPDX-License-Identifier: Apache-2.0

config SYSTEM_APP_MOUNT_SYSTEM
    bool "mount-system (/bin/mount)"
    default y
    depends on SYSTEM_APP_FS_BACKEND_SYSTEM
    help
        Build and deploy hyper-mount-system at /bin/mount.
```
